## meta-pine64/conf/bblayers.conf.sample
```bitbake
# LAYER_CONF_VERSION is increased each time build/conf/bblayers.conf
# changes incompatibly
LCONF_VERSION = "6"

BBPATH = "${TOPDIR}"
BBFILES ?= ""

BBLAYERS ?= " \
  ##ISARROOT##/meta \
  ##ISARROOT##/meta-isar \
  ##PINE64ROOT##/meta-pine64 \
  "
BBLAYERS_NON_REMOVABLE ?= " \
  ##ISARROOT##/meta \
  "
```

## meta-pine64/conf/layer.conf
```bitbake
# This software is a part of ISAR.
# Copyright (C) 2015-2017 ilbers GmbH
# Copyright (C) Vijai Kumar K <vijaikumar.kanagarajan@gmail.com>, 2019

# We have a conf and classes directory, add to BBPATH
BBPATH .= ":${LAYERDIR}"

# We have recipes-* directories, add to BBFILES
BBFILES +=  "${LAYERDIR}/recipes-*/*/*.bb \
            ${LAYERDIR}/recipes-*/*/*.bbappend"

BBFILE_COLLECTIONS += "pine64"
BBFILE_PATTERN_pine64 = "^${LAYERDIR}/"
BBFILE_PRIORITY_pine64 = "20"

# This should only be incremented on significant changes that will
# cause compatibility issues with other layers
LAYERVERSION_pine64 = "3"
LAYERSERIES_COMPAT_pine64 = "v0.6"
LAYERDEPENDS_pine64 = "core"

LAYERDIR_pine64 = "${LAYERDIR}"
```

## meta-pine64/conf/machine/pine64-plus.conf
```bitbake
# This software is a part of ISAR.
# Copyright (C) 2015-2017 ilbers GmbH
# Copyright (c) Vijai Kumar K <vijaikumar.kanagarajan@gmail.com>, 2019

MACHINE_SERIAL ?= "ttyS0"
BAUDRATE_TTY ?= "115200"

IMAGE_TYPE ?= "wic-img"
WKS_FILE ?= "pine64-plus.wks.in"
QEMU_ARCH = "arm64"

PREFERRED_VERSION_linux-mainline = "5.4.6"

U_BOOT_CONFIG_pine64-plus = "pine64_plus_defconfig"
U_BOOT_BIN_pine64-plus = "u-boot-sunxi-with-spl.bin"
IMAGER_INSTALL += "u-boot-${MACHINE}"
IMAGE_INSTALL += "u-boot-tools u-boot-script expand-on-first-boot pine64-extensions"
IMAGE_PREINSTALL += "ifupdown iputils-ping isc-dhcp-client vim"
```
